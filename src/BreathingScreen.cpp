#include <BreathingScreen.h>
#include <Hardware.h>

const uint16_t secondaryColor = tft.color565(184, 184, 184);

const uint16_t scroll_wheel[16*84] PROGMEM  = {
  0x0000, 0x0000, 0x0000, 0x0000, 0x0000, 0x0000, 0x0000, 0x0000, 0x0000, 0x0000, 0x0000, 0x0000, 0x0000, 0x0000, 0x0000, 0x0000, 
  0x0000, 0x0000, 0x0000, 0x0000, 0x0000, 0x0000, 0x0000, 0x0000, 0x0000, 0x0000, 0x0000, 0x0000, 0x0000, 0x0000, 0x0000, 0x0000, 
  0x0000, 0x0000, 0x0000, 0x0000, 0x0000, 0x0000, 0x0000, 0x0000, 0x0000, 0x0000, 0x0000, 0x0000, 0x0000, 0x0000, 0x0000, 0x0000, 
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  0x0000, 0x0000, 0x0000, 0x0000, 0x0000, 0x0000, 0x0000, 0x0000, 0x0000, 0x0000, 0x0000, 0x0000, 0x0000, 0x0000, 0x0000, 0x0000
};

const uint16_t defaultStart[84*24] PROGMEM  = {
  0x0000, 0x0000, 0x0000, 0x0000, 0x0820, 0x0000, 0x0000, 0x0000, 0x0000, 0x0000, 0x0020, 0x0820,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 0x0000, 
  0x0000, 0x0000, 0x0000, 0x0000, 0x0820, 0x0020, 0x4a08, 0x4208, 0x4208, 0x4208, 0x4208, 0x4208,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 0x0000, 
  0x0000, 0x0000, 0x0000, 0x1061, 0x4208, 0x4208, 0x4208, 0x4208, 0x4208, 0x4208, 0x4208, 0x4208,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 0x0000, 
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  0x0000, 0x0000, 0x0000, 0x0000, 0x0000, 0x0000, 0x1061, 0x4a08, 0x4208, 0x4208, 0x4208, 0x4208,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 0x0000
};

const uint16_t pressedStart[84*24] PROGMEM  = {
  0x0000, 0x0000, 0x0000, 0x0000, 0x0000, 0x0000, 0x0000, 0x0000, 0x0000, 0x0000, 0x0000, 0x0000,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 0x0000, 
  0x0000, 0x0000, 0x0000, 0x0000, 0x0000, 0x0000, 0x2104, 0x94b2, 0xbdf7, 0xbdf7, 0xbdf7, 0xbdf7,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 0x0000, 
  0x0000, 0x0000, 0x0000, 0x0000, 0x2945, 0x6b6d, 0xbdf7, 0xbdf7, 0xbdf7, 0xbdf7, 0xbdf7, 0xbdf7,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 0x0000, 
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  0x0000, 0x0000, 0x0000, 0x0000, 0x0000, 0x0000, 0x0000, 0x10a2, 0x94b2, 0xbdf7, 0xbdf7, 0xbdf7,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 0x0000
};

const uint16_t heart[12*12] PROGMEM = {
  0x4208, 0x4208, 0x4208, 0x4208, 0x4208, 0x4208, 0x4208, 0x4208, 0x4208, 0x4208, 0x4208, 0x4208, 
  0x4208, 0xFFFF, 0xFFFF, 0xFFFF, 0x4208, 0x4208, 0x4208, 0xFFFF, 0xFFFF, 0xFFFF, 0x4208, 0x4208, 
  0xFFFF, 0xFFFF, 0xFFFF, 0xFFFF, 0xFFFF, 0x4208, 0xFFFF, 0xFFFF, 0xFFFF, 0xFFFF, 0xFFFF, 0x4208, 
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  0x4208, 0x4208, 0x4208, 0x4208, 0x4208, 0xFFFF, 0x4208, 0x4208, 0x4208, 0x4208, 0x4208, 0x4208, 
};

BreathingState breathingState;


// countdown var
int countdownBreathing = 3;
unsigned long lastMillisCounter = 0;
unsigned long waitTime = 1000;
bool dirtyBegin = false;
bool dirtyCountdownSec = false;

// sim var 
unsigned long boxBreathingStart = 0;
unsigned long boxBreathingElapsed = 0;
int lastSecBox = -1;
bool dirtyMode, dirtyBox = false;
float x_pos = 88, y_pos = 84;
int i, j; 
float last_x = 88, last_y = 84;
String mode = "BREATHE IN";
bool staticBox = false;
bool invalidScreen = true;
int modeStage = 0;
long secBox = 0;
bool countBox = false;


void updateBoxBreathing(){
    if(digitalRead(BUTTON_START)==LOW){
        if(breathingState == MENU_STATE){
            countdownBreathing = 3;
            x_pos = 88, y_pos = 84;
            dirtyCountdownSec = true;
            secBox = 0;
            breathingState = COUNTDOWN_STATE;
        }
    }
    if(digitalRead(BUTTON_STOP)==LOW){
        breathingState = MENU_STATE;
        staticBox = false;
    }
    invalidScreen = true;

}

void drawBoxBreathing(){
    if(breathingState == MENU_STATE){
        drawMenuState();


    } else if(breathingState == COUNTDOWN_STATE){
       countdown();
    } else if(breathingState == SIMULATION_STATE){
        updateSim();
        drawSim();
    }

    // img.unloadFont();
    img.pushSprite(0,0);
}

void drawMenuState(){
    img.fillSprite(TFT_BLACK);
    img.setTextSize(1);
    img.pushImage(10, 77, 16, 84, scroll_wheel);
    img.setFont(&roboto20);
    img.setTextDatum(CL_DATUM);
    img.drawString("BOX", 42, 80);
    img.drawString("BREATHING", 42, 98);
    img.pushImage(42, 143, 84, 24, defaultStart); 
}
void countdown(){
  unsigned long currentMs = millis();
  img.fillSprite(TFT_BLACK);
  img.setFont(&baloo46);
  img.setTextDatum(CC_DATUM);
  img.setTextSize(3);

  if(countdownBreathing == 0) {
    
    if(currentMs - lastMillisCounter >= waitTime) {
        img.setFont(&roboto20);
        img.fillSprite(TFT_BLACK);
        tone(BUZZER, 1200, 500);
        img.drawString("BEGIN", 128, 128);
        breathingState = SIMULATION_STATE;
        lastMillisCounter = currentMs;
        invalidScreen = true;
        countBox = true;
        boxBreathingStart = millis();
    }
    return;
  }
  
  if (currentMs - lastMillisCounter >= waitTime) {
        img.fillSprite(TFT_BLACK);
        tone(BUZZER, 1000, 500);
        img.drawString(String(countdownBreathing), 128, 128);
        
        countdownBreathing--;

        lastMillisCounter = currentMs;
      }
}

void updateSim(){
    // boxBreathingElapsed = millis() - boxBreathingStart;

    // secBox = (boxBreathingElapsed / 1000);

    secBox = (millis()-boxBreathingStart) / 1000;

    
    if(secBox !=lastSecBox){
        lastSecBox = secBox;

    if(modeStage == 0 && lastSecBox == 0){ // Breathe in
        mode = "BREATHE IN";
        i=1; j=0;
        dirtyMode = true;
        modeStage++;
    } else if(modeStage == 1  && lastSecBox == 4){ // hold
        mode = "HOLD";
        i=0; j=1;
        dirtyMode = true;
        modeStage++;
    } else if(modeStage == 2 && lastSecBox == 8){ // breathe out
        mode = "BREATHE OUT";
        i=-1; j=0;
        dirtyMode = true;
        modeStage++;
    } else if(modeStage == 3 && lastSecBox == 12){ // hold
        mode = "HOLD";
        i=0; j=-1;
        dirtyMode = true;
        modeStage++;
    } else if(modeStage == 4  && lastSecBox == 16){ // reset
        x_pos = 88;
        y_pos = 84;
        Serial.println("sim ended");

        staticBox = false;
        breathingState = MENU_STATE;
        boxBreathingStart =  0;
        secBox = 0;
        modeStage = 0;
        dirtyMode = false;
        invalidScreen = true;
        dirtyBox = false;
        countBox = false;
        return;
    }
    Serial.println("second" + String(secBox));
    Serial.println("modeStage" + String(modeStage));
    }
    
    
    
    x_pos+=0.4*i;
    y_pos+=0.4*j;

    dirtyBox = true;
}

void drawSim(){
    img.setTextSize(1);
    img.setTextDatum(CC_DATUM);
    img.setFont(&roboto20);
    if(invalidScreen){
        img.fillSprite(TFT_BLACK);
    }
    img.setFont(&fonts::Font4);
    img.drawRect(87, 83, 64, 64, TFT_WHITE);
    img.fillRect(56, 161, 128, 40, 0x4208);
    img.drawRect(57, 162, 126, 38, secondaryColor);
    img.pushImage(67, 169, 12, 12, heart);
    img.setTextFont(2);
    // img.drawString("141", 73, 188);
    img.drawString("Press [STOP] to exit", 128, 209);
    staticBox = true;
    

    // if(!dirtyMode && !dirtyBox){
    //     img.fillRect(100, 64, 70, 35, TFT_CYAN);
    //     img.drawString(mode, 128, 66); 
    //     img.drawCircle(x_pos, y_pos, 4, TFT_RED);
    // }

    if(state.dirtyHeartRate || invalidScreen) {
        img.fillRect(67, 185, 10, 9, 0x4208);
        img.drawString(String(int(state.bpm)), 73, 190);
        state.dirtyHeartRate = false;
    }

    if(dirtyMode || invalidScreen) {
        img.fillRect(40, 40, 200, 40, TFT_BLACK);
        img.drawString(mode, 128, 66); 
        dirtyMode = false;
    }

    if(dirtyBox || invalidScreen) {
        img.fillCircle(last_x, last_y, 4, TFT_BLACK);

        if(last_x - 4 <= 87 || last_x + 4 >= 151 || last_y - 4 <= 83 || last_y + 4 >= 147){
            img.drawRect(87, 83, 64, 64, TFT_WHITE);
        }
        
        img.fillCircle(x_pos, y_pos, 4, 0xF800);

        last_x = x_pos;
        last_y = y_pos;
        dirtyBox = false;
    }
    invalidScreen = false;
}
